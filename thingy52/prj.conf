## CMakeLists.txt
```
cmake_minimum_required(VERSION 3.20.0)

# set board variable to thingy:52 for cross-compilation, needs to be done before including/finding zephyr
set(BOARD "thingy52_nrf52832")

find_package(Zephyr REQUIRED HINTS $ENV{ZEPHYR_BASE})
project(bluetooth_connection)

target_sources(app PRIVATE
	src/main.c
	src/thingy_bt.c
	src/leds.c
	src/sensor.c
)
```

## prj.conf
```kconfig
CONFIG_USE_SEGGER_RTT=y
CONFIG_RTT_CONSOLE=y

CONFIG_BT=y
CONFIG_BT_DEBUG_LOG=y
CONFIG_BT_SMP=y
CONFIG_BT_PERIPHERAL=y
CONFIG_BT_DIS=y
CONFIG_BT_DIS_PNP=n
CONFIG_BT_BAS=y
CONFIG_I2C=y
CONFIG_BT_DEVICE_NAME="group3_tiago"
CONFIG_BT_DEVICE_NAME_DYNAMIC=y
CONFIG_BT_DEVICE_APPEARANCE=768
CONFIG_BT_ATT_ENFORCE_FLOW=n
```

## src/main.c
```c
// Common includes
#include <stddef.h>
#include <stdio.h>
#include <string.h>
#include <stdlib.h>
#include <zephyr/kernel.h>
#include <zephyr/sys/printk.h>
#include <zephyr/sys/util.h>
#include <zephyr/types.h>

#include "leds.h"
#include "sensor.h"
#include "thingy_bt.h"

#define DELAY_TIME 3

void main(void) {
  if (init_leds()) {
    printk("Having some troubles with the initialization of the leds... Help");
    exit(-1);
  }

  if (init_sensor()) {
    printk("Having some troubles with the initialization of the sensor... Help");
    exit(-1);
  }

  if (init_bt()) {
    printk("Having some troubles with the bluetooth thing... Help");
    exit(-1);
  }

  while (1) {
    notify_server();
    k_sleep(K_SECONDS(3));
  }
}
```

## src/leds.c
```c
#include <zephyr/kernel.h>
#include <zephyr/drivers/gpio.h>
#include <stdlib.h>

#include "leds.h"

#define LED0_NODE DT_ALIAS(led0)
#define LED1_NODE DT_ALIAS(led1)
#define LED2_NODE DT_ALIAS(led2)

/*
 * A build error on this line means your board is unsupported.
 * See the sample documentation for information on how to fix this.
 */
static const struct gpio_dt_spec led0 = GPIO_DT_SPEC_GET(LED0_NODE, gpios);
static const struct gpio_dt_spec led1 = GPIO_DT_SPEC_GET(LED1_NODE, gpios);
static const struct gpio_dt_spec led2 = GPIO_DT_SPEC_GET(LED2_NODE, gpios);

RGBColors colors[NUM_COLORS] = {
    {0, 1, 1},
    {1, 0, 1},
    {1, 1, 0},
    {0, 0, 1},
    {0, 1, 0},
};

void turn_on_color(Color c) {
    gpio_pin_set_dt(&led0, colors[c].r);
    gpio_pin_set_dt(&led1, colors[c].g);
    gpio_pin_set_dt(&led2, colors[c].b);
}

int init_leds(void)
{
    if (!gpio_is_ready_dt(&led0) &&
        gpio_pin_configure_dt(&led0, GPIO_OUTPUT_ACTIVE) < 0) {
		return -1;
	}
    if (!gpio_is_ready_dt(&led1) &&
        gpio_pin_configure_dt(&led1, GPIO_OUTPUT_ACTIVE) < 0) {
		return -1;
	}
    if (!gpio_is_ready_dt(&led2) &&
        gpio_pin_configure_dt(&led2, GPIO_OUTPUT_ACTIVE) < 0) {
		return -1;
	}
    return 0;
}
```

## src/leds.h
```c
#ifndef leds_h
#define leds_h

typedef enum {
    red,
    green,
    blue,
    yellow,
    purple,
    NUM_COLORS
} Color;

/**
 * @brief 
 * 
 */
typedef struct {
    unsigned int r;
    unsigned int g;
    unsigned int b;
} RGBColors;

/**
 * @brief Displays the given color on the thingy52
 * 
 * @param c Color to display
 */
void turn_on_color(Color c);

/**
 * @brief Initializes the leds
 * 
 */
int init_leds(void);

#endif
```

## src/sensor.c
```c
#include "sensor.h"
#include "leds.h"
#include <zephyr/drivers/sensor.h>

// https://docs.zephyrproject.org/2.7.5/boards/arm/thingy52_nrf52832/doc/index.html
// example in ncs/zepyhr/samples/hts221/src/main.c
// https://docs.zephyrproject.org/latest/samples/sensor/hts221/README.html
static const struct device *sensor = DEVICE_DT_GET_ONE(st_hts221);
double temperature;
double humidity;
uint32_t timestamp;

/**
 * @brief Get the temperature from the sensor and write it on <VARIABLE NAME>
 * https://docs.zephyrproject.org/latest/hardware/peripherals/sensor.html#triggers
 * https://docs.zephyrproject.org/2.7.5/reference/kernel/timing/clocks.html?highlight=time#uptime
 * @param dev temperature device
 * @param trig trigger configuration
 */
static void get_measurements(const struct device *dev,
                            const struct sensor_trigger *trig) {
    struct sensor_value temp, hum;
    int error;
    if ((error = sensor_sample_fetch(dev)) < 0) {
        printk("Sensor sample_fetch error: %d\n", error);
        return;
    }

    if ((error = sensor_channel_get(dev, SENSOR_CHAN_AMBIENT_TEMP, &temp)) < 0) {
        printk("Error while getting the temperature from the AMBIENT_TEMP channel: %d\n", error);
        return;
    }
    if (sensor_channel_get(dev, SENSOR_CHAN_HUMIDITY, &hum) < 0) {
        printf("Cannot read HTS221 humidity channel\n");
        return;
    }
    timestamp = k_uptime_get_32();
    temperature = sensor_value_to_double(&temp);
    humidity = sensor_value_to_double(&hum);

    turn_on_color(green);
    printk("<%d> Temperature/Humidity are approximately %d.%02dC|%d.%02d%%\n", timestamp, temp.val1, temp.val2, hum.val1, hum.val2);
}

int init_sensor() {
    if (!device_is_ready(sensor)) {
        printk("init_sensor failed: sensor not ready\n");
        return -1;
    }

    if (IS_ENABLED(CONFIG_HTS221_TRIGGER)) {
        // https://docs.zephyrproject.org/latest/hardware/peripherals/sensor.html#c.sensor_trigger
        // it doesn't work if I put two triggers
        struct sensor_trigger temp_hum_trigger = {
            .type = SENSOR_TRIG_DATA_READY,
            .chan = SENSOR_CHAN_ALL,
        };
        if (sensor_trigger_set(sensor, &temp_hum_trigger, get_measurements) < 0) {
            printk("init_sensor failed: cannot configure the temp_hum_trigger\n");
            return -1;
        }

        printk("Temperature/Humidity sensor successfully initialized.\n");
        return 0;
    }

    printk("init_sensor failed: trigger config not enabled\n");
    return -1;
}
```

## src/sensor.h
```c
#ifndef sensor_h
#define sensor_h

/**
 * @brief Initializes the sensor of the temperature and humidity
 * 
 * @return int 0 if success, -1 otherwise
 */
int init_sensor();

#endif
```

## src/thingy_bt.c
```c
#include <zephyr/bluetooth/bluetooth.h>
#include <zephyr/bluetooth/conn.h>
#include <zephyr/bluetooth/gatt.h>
#include <zephyr/bluetooth/hci.h>
#include <zephyr/bluetooth/uuid.h>
#include <zephyr/sys/byteorder.h>
#include <stdlib.h>

#include "leds.h"

#define DEVICE_NAME CONFIG_BT_DEVICE_NAME
#define DEVICE_NAME_LEN (sizeof(DEVICE_NAME) - 1) // null terminator
#define BT_UUID_HTS_INTERMEDIATE BT_UUID_DECLARE_16(0x2a1e)

/*
 * Define and register service
 */
BT_GATT_SERVICE_DEFINE(health_thermometer_svc,
    BT_GATT_PRIMARY_SERVICE(BT_UUID_HTS),
    BT_GATT_CHARACTERISTIC(
	BT_UUID_HTS_INTERMEDIATE,
	BT_GATT_CHRC_NOTIFY,
        BT_GATT_PERM_READ,
	NULL, NULL, NULL
    ),
    BT_GATT_CCC(NULL, BT_GATT_PERM_READ | BT_GATT_PERM_WRITE),
);

/**
 * Data to advertise in the advertisement packets
 */
static const struct bt_data advertisement_pk[] = {
    BT_DATA_BYTES(BT_DATA_FLAGS, BT_LE_AD_GENERAL),
    BT_DATA_BYTES(
        BT_DATA_UUID16_ALL,
        BT_UUID_16_ENCODE(BT_UUID_HTS_VAL)
    ), // Advertising Health Termometer Service
};

/* Data to scan in response packets */
static const struct bt_data response_pk[] = {
    BT_DATA(
            BT_DATA_NAME_COMPLETE,
            DEVICE_NAME,
            DEVICE_NAME_LEN
    ), // Scanning name of device
};

// Create an array to store the bytes of the doubles
static uint8_t data[sizeof(uint32_t) + 2 * sizeof(double)];

/**
 * Initializes the bluetooth device and starts advertisement
 */
static void bt_ready (int error) {
  bt_addr_le_t address = {0};
  char address_string[BT_ADDR_LE_STR_LEN];
  size_t counter = 1;

  if (error) {
    printk("Bluetooth initialization failed | Error: %d\n", error);
    exit(-1);
  }

  printk("Bluetooth successfully initialized\n");

  /* Start the advertisement */
  error = bt_le_adv_start(
		BT_LE_ADV_CONN,
		advertisement_pk,
		ARRAY_SIZE(advertisement_pk),
		response_pk,
		ARRAY_SIZE(response_pk)
  );
  if (error) {
    printk("Troubles while starting the advertisement | Error: %d\n", error);
    exit(-1);
  }

  bt_id_get(&address, &counter);
  bt_addr_le_to_str(&address, address_string, sizeof(address_string));

  printk("Beacon started | Advertising as %s\n", address_string);
}

/**
 * Callback function called when device connects via bluetooth
 *
 * @param connection Established bluetooth connection
 * @param error Error value 0 if everything ok
 */
static void bt_connected(struct bt_conn *connection, uint8_t error) {
  if (error) {
    printk("Troubles while connecting via bluetooth | Error: %d\n", error);
  }
  turn_on_color(yellow);
  printk("Bluetooth connected\n");
}

/**
 * Callback function called when a device disconnecs via bluetooth
 *
 * @param connection Bluetooth connection that was removed
 * @param reason Reason why the connection was removed
 */
static void bt_disconnected(struct bt_conn *connection, uint8_t reason) {
  printk("Bluetooth disconnected | Reason: %d\n", reason);
  turn_on_color(purple);
}

/**
 * Struct with the callback functions for the
 * connection/disconnection of the bluetooth connections
 */
static struct bt_conn_cb bt_connection = {
    .connected = bt_connected,
    .disconnected = bt_disconnected,
};

/**
 * Send data to the server without expecting any acknowledgment
 */
void notify_server() {
  turn_on_color(red);
  extern uint32_t timestamp;
  extern double temperature;
  extern double humidity;

  memcpy(&data[0], &timestamp, sizeof(uint32_t));
  memcpy(&data[sizeof(uint32_t)], &temperature, sizeof(double));
  memcpy(&data[sizeof(uint32_t) + sizeof(double)], &humidity, sizeof(double));

  bt_gatt_notify(
    NULL,
    &health_thermometer_svc.attrs[1],
    data,
    sizeof(data)
  );

  printk("Server notified.\n");
}

int init_bt() {
  // Initialize the bluetooth device
  int error = bt_enable(bt_ready);
  if (error) {
    printk("Bluetooth initialization failed | Error: %d\n", error);
    exit(-1);
  }

  // Register the callback functions for bluetooth connections
  bt_conn_cb_register(&bt_connection);
  return 0;
}
```

## src/thingy_bt.h
```c
#ifndef thingy_bt_h
#define thingy_bt_h

/**
 * Sends data to the server without expecting any acknowledgment
 */
void notify_server();

/**
 * Init bluetooth and wait for conn
 */
int init_bt();

#endif
```
